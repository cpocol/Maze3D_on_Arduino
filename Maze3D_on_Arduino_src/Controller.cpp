#include <arduino.h>
#include <ctype.h>
#include <math.h>
#include <time.h>
#include "Config.h"
#include "Controller.h"
#include "main.h"
#include "Map.h"

#include "acceleratedMotion.h" // generated by "Generate acceleratedMotion.cpp" (run it with CodeBlocks)

#define JOYSTICK_X_PIN A6
#define JOYSTICK_Y_PIN A7
#define JOYSTICK_BUTTON_PIN 2

// jump
int verticalAdvance = 0;
int jumping = 0;
int z = 0; // same unit as sqRes
int maxJump_idx;

void move(int32_t& x, int32_t& y, int16_t angle, float speed) {
    float rad = angle * 6.2831f / around;
    fptype xTest = x + int(speed * cos(rad));
    fptype yTest = y + int(speed * sin(rad));

    // check for wall collision
    int safetyX = ((aroundq < angle) && (angle < around3q)) ? +safety_dist : -safety_dist;
    int safetyY = (angle < aroundh) ? -safety_dist : +safety_dist;
    int adjXMap = ((aroundq < angle) && (angle < around3q)) ? -1 : 0;
    int adjYMap = (angle > aroundh) ? -1 : 0;

    TCastResponse result = Cast(angle);
    if (sq(x - xTest) + sq(y - yTest) >= sq(x - result.xHit) + sq(y - result.yHit)) { // inside wall
        if (!result.horizontalWall) { // vertical wall ||
            x = result.xHit + safetyX;
            y = yTest;                          //                __
            if (MAP(y / sqRes, x / sqRes) != 0) // it's a corner |
                y = (yTest / sqRes - adjYMap) * sqRes + safetyY;
        }
        else { // horizontal wall ==
            x = xTest;
            y = result.yHit + safetyY;          //                __
            if (MAP(y / sqRes, x / sqRes) != 0) // it's a corner |
                x = (xTest / sqRes - adjXMap) * sqRes + safetyX;
        }
    }
    else // free cell
        x = xTest, y = yTest;
}

void rotate(int16_t& angle, int speed, int around) {
    angle = (angle + speed + around) % around;
}

void initController() {
    // search for the acceleratedMotion entry so that we'll decelerate to zero speed at max jump height
    for (maxJump_idx = 0; maxJump_idx < 200; maxJump_idx++)
        if (acceleratedMotion[maxJump_idx] > maxJumpHeight)
            break;

    if (maxJump_idx >= 200) maxJump_idx = 199;

    elevation_perc = 100 * z / sqResh; // as percentage from wall half height

    pinMode(JOYSTICK_BUTTON_PIN, INPUT_PULLUP);
}

void loopController(int32_t& x, int32_t& y, int16_t& angle, int around) {
    int xValue = analogRead(JOYSTICK_X_PIN); // larger values leftwards
    int yValue = analogRead(JOYSTICK_Y_PIN); // larger values forward
    int button = digitalRead(JOYSTICK_BUTTON_PIN); // 0/1 = pressed/not pressed

    bool bJump = false;
    if (button == 0)
        bJump = true;
    else {
#define TH_LEFT 0.51f
#define TH_RIGHT 0.49f
#define TH_FORWARD 0.51f
#define TH_BACKWARD 0.49f
        if (xValue > (1024 * TH_LEFT)) // rotate left
            rotate(angle, -ROTATE_SPD * (xValue - 1024 * TH_LEFT) / (1024 - 1024 * TH_LEFT), around);
        if (xValue < (1024 * TH_RIGHT)) // rotate right
            rotate(angle, +ROTATE_SPD * (1024 * TH_RIGHT - xValue) / (1024 * TH_RIGHT), around);

        if (yValue > (1024 * TH_FORWARD)) // pedal forward
            move(x, y, angle, MOVE_SPD * (yValue - 1024 * TH_FORWARD) / (1024 - 1024 * TH_FORWARD));
        if (yValue < (1024 * TH_BACKWARD)) // pedal backward
            move(x, y, (angle + around / 2) % around, MOVE_SPD * (1024 * TH_BACKWARD - yValue) / (1024 * TH_BACKWARD));

        xCMap = x >> sqRes_pow2;
        yCMap = y >> sqRes_pow2;

        xC_fp = (fptype)x << fp;
        yC_fp = (fptype)y << fp;
    }

    // jump
    static int jump_idx;
    if (bJump && !jumping) {
        jumping = 1;
        verticalAdvance = 1;
        jump_idx = maxJump_idx - 1;
        z = maxJumpHeight - acceleratedMotion[jump_idx];
    }
    else
    if (jumping) {
        if (verticalAdvance > 0) {
            if (jump_idx > 0) {
                jump_idx--;
                z = maxJumpHeight - acceleratedMotion[jump_idx];
            }
            else {
                verticalAdvance = -1;
                z = maxJumpHeight;
            }
        }
        else
        if (verticalAdvance < 0) {
            if (z > 0) {
                jump_idx++;
                z = max(0, maxJumpHeight - acceleratedMotion[jump_idx]);
            }
            else {
                verticalAdvance = 0;
                jumping = 0;
            }
        }
    }

    elevation_perc = 100 * z / sqResh; // as percentage from wall half height
}
